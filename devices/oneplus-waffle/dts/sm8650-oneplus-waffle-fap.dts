// SPDX-License-Identifier: (GPL-2.0+ OR BSD-3-Clause)
/*
 * OnePlus 12 first light, plain variant: debug initramfs only (USB serial +
 * telnet on 172.16.42.1). Memory: the board DT's full map, which is exactly
 * what ABL writes into /memory on this unit (LineageOS
 * /sys/firmware/devicetree/base/memory/reg, OnePlus12/log/stock-memory-map.txt;
 * MemTotal 15.6 GB). uniLoader passes no memory node of its own, so the DT's
 * is the one the kernel gets. uniLoader's leftovers (0xa8010000.., ramdisk
 * copy at 0xb6f95000, reserved by the kernel via linux,initrd-*) sit in
 * System RAM on both maps.
 */
/dts-v1/;

#include "sm8650-oneplus-waffle-fap.dtsi"

/ {
	chosen {
		bootargs = "console=tty0 loglevel=7 ignore_loglevel printk.devkmsg=on clk_ignore_unused pd_ignore_unused regulator_ignore_unused nokaslr fbcon=font:TER16x32";
	};
};
